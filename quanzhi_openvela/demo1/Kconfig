## quanzhi_openvela/demo1/express_ui/Kconfig
```kconfig
menuconfig DEMO1_EXPRESS_UI
	tristate "Express sorting terminal UI"
	default n
	depends on GRAPHICS_LVGL
	help
		Smart express sorting terminal user interface.

if DEMO1_EXPRESS_UI

config DEMO1_EXPRESS_UI_PRIORITY
	int "Express UI task priority"
	default 100

config DEMO1_EXPRESS_UI_STACKSIZE
	int "Express UI stack size"
	default 40960

config DEMO1_EXPRESS_UI_INPUT_DEVPATH
	string "Touchscreen device path"
	default "/dev/input0"
	depends on INPUT_TOUCHSCREEN
	help
		The path to the touchscreen device.
endif
```

## quanzhi_openvela/demo1/sound_app/Kconfig
```kconfig
config EXAMPLES_SOUND_APP
    bool "sound app for Xiaozhi STT"
    default n

if EXAMPLES_SOUND_APP

config EXAMPLES_SOUND_APP_PROGNAME
    string "Program name"
    default "sound_app"

config EXAMPLES_SOUND_APP_PRIORITY
    int "Task priority"
    default 100

config EXAMPLES_SOUND_APP_STACKSIZE
    int "Stack size"
    default 32768

endif
```

## quanzhi_openvela/wifi_auto/Kconfig
```kconfig
config EXAMPLES_WIFI_AUTO
	tristate "WiFi auto connect app"
	default n
	---help---
		Automatically connect wlan0 to the configured Wi-Fi hotspot.
```
